/*
 * File: DOT_MATRIX.c
 * Driver Name: [[ DOT MATRIX MAX7219 ]]
 * SW Layer:   ECUAL
 * Created on: Jun 28, 2020
 * Author:     Khaled Magdy
 * -------------------------------------------
 * For More Information, Tutorials, etc.
 * Visit Website: www.DeepBlueMbedded.com
 *
 */

#include "DOT_MATRIX.h"
#include "DOT_MATRIX_cfg.h"

//---------------------------[ Globals ]---------------------------

SPI_HandleTypeDef * g_hspi;

typedef struct
{
	uint32_t  Ticks;
	uint32_t  Max_Ticks;
	uint16_t  Arr_Index;
	uint8_t   Col_Index;
	uint8_t   BufferInit;
	uint8_t   Buffer[MAX_CASCADED_NUM*8];
	uint16_t  ArrSize;
	char*     ArrPtr;
}DOT_MATRIX_info;

static DOT_MATRIX_info gs_MATRIX_info[DOT_MATRIX_UNITS] = {0};

// Font 7x5 Bitmap (ASCII)
char FONT_7x5[96][5] = {
 {0b00000000,0b00000000,0b00000000,0b00000000,0b00000000}, // space
 {0b00000000,0b00000000,0b01001111,0b00000000,0b00000000}, // !
 {0b00000000,0b00000111,0b00000000,0b00000111,0b00000000}, // "
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 {0b00001000,0b00000100,0b00000100,0b00001000,0b00000100}  // ~
};

uint32_t welcome_msg[32] = {
		0b00000000000000000000000000000000,
		0b00000000000000000000000000000000,
		0b00000000000000000000000000000000,
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		0b00000000000000000000000000000000,
		0b00000000000000000000000000000000
};

uint32_t pong_msg[32] = {
		0b00000000000000000000000000000000,
		0b00000000000000000000000000000000,
		0b00000000000000000000000000000000,
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		0b00000000000000000000000000000000,
		0b00000000000000000000000000000000
};

uint32_t snake_msg[32] = {
		0b00000000000000000000000000000000,
		0b00000000000000000000000000000000,
		0b00000000000000000000000000000000,
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		0b00000000000000000000000000000000,
		0b00000000000000000000000000000000
};

uint32_t tetris_msg[32] = {
		0b00000000000000000000000000000000,
		0b00000000000000000000000000000000,
		0b00000000000000000000000000000000,
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		0b00000000000000000000000000000000,
		0b00000000000000000000000000000000
};

uint32_t conway_msg[32] = {
		0b00000000000000000000000000000000,
		0b00000000000000000000000000000000,
		0b00000000000000000000000000000000,
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		0b00000000000000000000000000000000,
		0b00000000000000000000000000000000
};

uint32_t gameover_msg[32] = {
		0b00000000000000000000000000000000,
		0b00000000000000000000000000000000,
		0b00000000000000000000000000000000,
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		0b00000000000000000000000000000000,
		0b00000000000000000000000000000000
};

//-----------------------------[ Static Functions' Definitions ]----------------------------

// Static Functions Used By Library But Not Visible To User Who Include The Library (Driver)

static void SPI_TX_Byte(uint8_t au8_DATA)
{
	HAL_SPI_Transmit(g_hspi, &au8_DATA, 1, 10);
}

static void SS_ENABLE(uint8_t au8_MATRIX_Instance)
{
	HAL_GPIO_WritePin(DOT_MATRIX_CfgParam[au8_MATRIX_Instance].SS_GPIO, DOT_MATRIX_CfgParam[au8_MATRIX_Instance].SS_PIN, 0);
}

static void SS_DISABLE(uint8_t au8_MATRIX_Instance)
{
	HAL_GPIO_WritePin(DOT_MATRIX_CfgParam[au8_MATRIX_Instance].SS_GPIO, DOT_MATRIX_CfgParam[au8_MATRIX_Instance].SS_PIN, 1);
}

static void TxByte(uint8_t au8_MATRIX_Instance, uint8_t au8_Col, uint8_t au8_Val)
{
	SS_ENABLE(au8_MATRIX_Instance);
	SPI_TX_Byte(au8_Col);
	SPI_TX_Byte(au8_Val);
	SS_DISABLE(au8_MATRIX_Instance);
}

static void PushToBuffer(uint8_t au8_MATRIX_Instance, uint8_t au8_NewByte)
{
	uint8_t i = 0;

	for(i = 0; i < DOT_MATRIX_CfgParam[au8_MATRIX_Instance].CASCADED_DEVICES*8 - 1; i++)
	{
		gs_MATRIX_info[au8_MATRIX_Instance].Buffer[i] = gs_MATRIX_info[au8_MATRIX_Instance].Buffer[i+1];
	}
	gs_MATRIX_info[au8_MATRIX_Instance].Buffer[DOT_MATRIX_CfgParam[au8_MATRIX_Instance].CASCADED_DEVICES*8 - 1] = au8_NewByte;
}

//----------------------------[ Library Functions' Definitions ]---------------------------

// Functions To Be Used By The User Who Include The Library (Driver)

void DOT_MATRIX_Init(SPI_HandleTypeDef * hspi)
{
	GPIO_InitTypeDef GPIO_InitStruct = {0};
    uint8_t i = 0, j = 0;

    g_hspi = hspi;

    /*--------[ Configure The SS GPIO Pins ]-------*/
    for(i = 0; i<DOT_MATRIX_UNITS; i++)
    {
    	if(DOT_MATRIX_CfgParam[i].SS_GPIO == GPIOA)
    	{
    		__HAL_RCC_GPIOA_CLK_ENABLE();
    	}
    	else if(DOT_MATRIX_CfgParam[i].SS_GPIO == GPIOB)
    	{
    		__HAL_RCC_GPIOB_CLK_ENABLE();
    	}
    	else if(DOT_MATRIX_CfgParam[i].SS_GPIO == GPIOC)
    	{
    		__HAL_RCC_GPIOC_CLK_ENABLE();
    	}
    	else if(DOT_MATRIX_CfgParam[i].SS_GPIO == GPIOD)
    	{
    		__HAL_RCC_GPIOD_CLK_ENABLE();
    	}
    	else if(DOT_MATRIX_CfgParam[i].SS_GPIO == GPIOE)
    	{
    		__HAL_RCC_GPIOE_CLK_ENABLE();
    	}
    	GPIO_InitStruct.Pin = DOT_MATRIX_CfgParam[i].SS_PIN;
    	GPIO_InitStruct.Mode = GPIO_MODE_OUTPUT_PP;
    	GPIO_InitStruct.Pull = GPIO_NOPULL;
    	GPIO_InitStruct.Speed = GPIO_SPEED_FREQ_LOW;
    	HAL_GPIO_Init(DOT_MATRIX_CfgParam[i].SS_GPIO, &GPIO_InitStruct);
    }
    /*--------[ Configure The SPI Peripheral ]-------*/
    g_hspi->Instance = DOT_MATRIX_SPI;
    g_hspi->Init.Mode = SPI_MODE_MASTER;
    g_hspi->Init.Direction = SPI_DIRECTION_2LINES;
    g_hspi->Init.DataSize = SPI_DATASIZE_8BIT;
    g_hspi->Init.CLKPolarity = SPI_POLARITY_LOW;
    g_hspi->Init.CLKPhase = SPI_PHASE_1EDGE;
    g_hspi->Init.NSS = SPI_NSS_SOFT;
    g_hspi->Init.BaudRatePrescaler = SPI_BAUDRATEPRESCALER_256;
    g_hspi->Init.FirstBit = SPI_FIRSTBIT_MSB;
    g_hspi->Init.TIMode = SPI_TIMODE_DISABLE;
    g_hspi->Init.CRCCalculation = SPI_CRCCALCULATION_DISABLE;
    g_hspi->Init.CRCPolynomial = 10;
    HAL_SPI_Init(g_hspi);

    /*--------[ Initialize & Configure The MAX7219 Devices ]-------*/
    for(i = 0; i<DOT_MATRIX_UNITS; i++)
    {
    	// Set BCD Decode Mode
    	SS_ENABLE(i);
    	for(j = 0; j<DOT_MATRIX_CfgParam[i].CASCADED_DEVICES; j++)
    	{
    	    SPI_TX_Byte(0x09);
    	    SPI_TX_Byte(0x00);
    	}
    	SS_DISABLE(i);
    	// Set Dot Matrix Unit Brightness
    	SS_ENABLE(i);
    	for(j = 0; j<DOT_MATRIX_CfgParam[i].CASCADED_DEVICES; j++)
    	{
    		SPI_TX_Byte(0x0A); // Select Intensity register
    		SPI_TX_Byte(DOT_MATRIX_CfgParam[i].BRIGHTNESS);
    	}
    	SS_DISABLE(i);
    	// Set Display Refresh
    	SS_ENABLE(i);
    	for(j = 0; j<DOT_MATRIX_CfgParam[i].CASCADED_DEVICES; j++)
    	{
    		SPI_TX_Byte(0x0B); // Select Scan-Limit register
    		SPI_TX_Byte(0x07); // 1-7
    	}
    	SS_DISABLE(i);
    	// Turn ON The Display
    	SS_ENABLE(i);
    	for(j = 0; j<DOT_MATRIX_CfgParam[i].CASCADED_DEVICES; j++)
    	{
    		SPI_TX_Byte(0x0C);
    		SPI_TX_Byte(0x01);
    	}
    	SS_DISABLE(i);
    	// Disable Display Test
    	SS_ENABLE(i);
    	for(j = 0; j<DOT_MATRIX_CfgParam[i].CASCADED_DEVICES; j++)
    	{
    		SPI_TX_Byte(0x0F);
    		SPI_TX_Byte(0x00);
    	}
    	SS_DISABLE(i);

        // Initialize The Global Structure
        gs_MATRIX_info[i].Ticks = 0;
        gs_MATRIX_info[i].BufferInit = 0;
        gs_MATRIX_info[i].Arr_Index = 0;
        gs_MATRIX_info[i].Col_Index = 0;
        gs_MATRIX_info[i].Max_Ticks = DOT_MATRIX_CfgParam[i].SCROLL_SPEED;
        for(j = 0; j < DOT_MATRIX_CfgParam[i].CASCADED_DEVICES*8; j++)
        {
        	gs_MATRIX_info[i].Buffer[j] = 0x00;
        }
    }
}

void DOT_MATRIX_Init_TMR(SPI_HandleTypeDef * hspi, TIM_HandleTypeDef* TMR_Handle)
{
	TIM_ClockConfigTypeDef sClockSourceConfig = {0};
    TIM_MasterConfigTypeDef sMasterConfig = {0};
    uint32_t ARR_Value = 0;

	DOT_MATRIX_Init(hspi);

	/*--------[ Configure The Matrix Timer Base If Enabled ]-------*/
    if(MATRIX_TIMER_EN == 1)
    {
    	ARR_Value = (MATRIX_TIMER_CLK * 10.0 * MATRIX_TIME_BASE);
    	TMR_Handle->Instance = MATRIX_TIMER;
    	TMR_Handle->Init.Prescaler = 99;
    	TMR_Handle->Init.CounterMode = TIM_COUNTERMODE_UP;
    	TMR_Handle->Init.Period = ARR_Value-1;
    	TMR_Handle->Init.ClockDivision = TIM_CLOCKDIVISION_DIV1;
    	TMR_Handle->Init.AutoReloadPreload = TIM_AUTORELOAD_PRELOAD_ENABLE;
    	HAL_TIM_Base_Init(TMR_Handle);
    	sClockSourceConfig.ClockSource = TIM_CLOCKSOURCE_INTERNAL;
    	HAL_TIM_ConfigClockSource(TMR_Handle, &sClockSourceConfig);
    	sMasterConfig.MasterOutputTrigger = TIM_TRGO_RESET;
    	sMasterConfig.MasterSlaveMode = TIM_MASTERSLAVEMODE_DISABLE;
    	HAL_TIMEx_MasterConfigSynchronization(TMR_Handle, &sMasterConfig);
    	HAL_TIM_Base_Start_IT(TMR_Handle);
    }
}

void MATRIX_SCROLL_SetSpeed(uint8_t au8_MATRIX_Instance, uint16_t au16_SPEED)
{
	gs_MATRIX_info[au8_MATRIX_Instance].Max_Ticks = au16_SPEED;
}

void MATRIX_CLEAR(uint8_t au8_MATRIX_Instance)
{
	uint8_t i = 0, col = 1;

	for(i = 0; i<DOT_MATRIX_CfgParam[au8_MATRIX_Instance].CASCADED_DEVICES; i++)
	{
		for(col = 1; col < 9; col++)
		{
			TxByte(au8_MATRIX_Instance, col, 0x00);
		}
	}
}

void MATRIX_Write_Char(uint8_t au8_MATRIX_Instance, uint8_t myChar)
{
    uint8_t Column = 1;
    uint8_t FONT_W = 5;

    TxByte(au8_MATRIX_Instance, Column, 0x00);
    for(Column=2; Column<=FONT_W+1; Column++)
    {
    	TxByte(au8_MATRIX_Instance, Column, FONT_7x5[myChar-32][Column-2]);
    }
    TxByte(au8_MATRIX_Instance, Column, 0x00);
}

void MATRIX_DisplayMessage(uint8_t au8_MATRIX_Instance, char* ArrayPointer, uint16_t ArraySize)
{
	gs_MATRIX_info[au8_MATRIX_Instance].ArrPtr = ArrayPointer;
	gs_MATRIX_info[au8_MATRIX_Instance].ArrSize = ArraySize-1;
	gs_MATRIX_info[au8_MATRIX_Instance].BufferInit = 1;
}


void MATRIX_display_buffer(uint8_t au8_MATRIX_Instance)
{
	uint8_t i = 0;

    for(i = 0; i<DOT_MATRIX_CfgParam[au8_MATRIX_Instance].CASCADED_DEVICES; i++)
    {
	    for(uint8_t j = 1; j < 9; j++)
	    {
	    	SS_ENABLE(au8_MATRIX_Instance);
		   for(uint8_t k = 0; k < i; k++)
		   {
			   SPI_TX_Byte(0x00);
		       SPI_TX_Byte(0x00);
		   }
		   SPI_TX_Byte(j);
		   SPI_TX_Byte(gs_MATRIX_info[au8_MATRIX_Instance].Buffer[j + i*8 - 1]);
		   for(uint8_t k = DOT_MATRIX_CfgParam[au8_MATRIX_Instance].CASCADED_DEVICES-1; k > i; k--)
		   {
			   SPI_TX_Byte(0x00);
			   SPI_TX_Byte(0x00);
		   }
		   SS_DISABLE(au8_MATRIX_Instance);
	    }
    }

}

void MATRIX_clear_buffer(uint8_t au8_MATRIX_Instance){
	for(uint8_t i = 0; i < DOT_MATRIX_CfgParam[au8_MATRIX_Instance].CASCADED_DEVICES*8; i++)
	{
		gs_MATRIX_info[au8_MATRIX_Instance].Buffer[i] =  0;
	}
}

void MATRIX_set_led(uint8_t au8_MATRIX_Instance, uint8_t x, uint8_t y, uint8_t state){

	uint8_t i=0;
	uint8_t byte=0;

	if(x<8){
		byte = (1<<(7-x));
		if(y<8) {
			i = y;
		} else if(y<16) {
			i = y+24;
		} else if(y<24) {
			i = y+48;
		} else {
			i = y+72;
		}
	} else if(x<16){
		byte = (1<<(7-(x-8)));
		if(y<8) {
			i = y+8;
		} else if(y<16) {
			i = y+32;
		} else if(y<24) {
			i = y+56;
		} else {
			i = y+80;
		}
	} else if(x<24){
		byte = (1<<(7-(x-16)));
		if(y<8) {
			i = y+16;
		} else if(y<16) {
			i = y+40;
		} else if(y<24) {
			i = y+64;
		} else {
			i = y+88;
		}
	} else {
		byte = (1<<(7-(x-24)));
		if(y<8) {
			i = y+24;
		} else if(y<16) {
			i = y+48;
		} else if(y<24) {
			i = y+72;
		} else {
			i = y+96;
		}
	}

	if(state){
		gs_MATRIX_info[au8_MATRIX_Instance].Buffer[i] =  gs_MATRIX_info[au8_MATRIX_Instance].Buffer[i] | byte;
	} else {
		byte = byte^0xFF;
		gs_MATRIX_info[au8_MATRIX_Instance].Buffer[i] =  gs_MATRIX_info[au8_MATRIX_Instance].Buffer[i] & byte;
	}



}

void DOT_MATRIX_Main(void)
{
	uint8_t i = 0, ch, space = 0;

	for(i=0; i<DOT_MATRIX_UNITS; i++)
	{
		if(gs_MATRIX_info[i].Ticks >= gs_MATRIX_info[i].Max_Ticks)
		{
			if(gs_MATRIX_info[i].BufferInit == 1 && DOT_MATRIX_CfgParam[i].SCROLL_Mode == SCROLL_MODE)
			{
				if(gs_MATRIX_info[i].Col_Index == 5)
				{
					gs_MATRIX_info[i].Arr_Index++;
					gs_MATRIX_info[i].Col_Index = 0;
					space = 1;
				}
				if(gs_MATRIX_info[i].Arr_Index == gs_MATRIX_info[i].ArrSize)
				{
					gs_MATRIX_info[i].Arr_Index = 0;
				}
				if(space)
				{
					PushToBuffer(i, 0x00); // Add White Space To Separate Characters
				}
				else
				{
					ch = (*(gs_MATRIX_info[i].ArrPtr + gs_MATRIX_info[i].Arr_Index)-32);
					PushToBuffer(i, FONT_7x5[ch][gs_MATRIX_info[i].Col_Index++]);
				}
				MATRIX_display_buffer(i);
			}
			gs_MATRIX_info[i].Ticks = 0;
		}
		else
		{
			gs_MATRIX_info[i].Ticks++;
		}
	}
}

void MATRIX_TMR_OVF_ISR(TIM_HandleTypeDef* htim)
{
	uint8_t i = 0, ch, space = 0;

	if(htim->Instance == MATRIX_TIMER)
	{
		for(i=0; i<DOT_MATRIX_UNITS; i++)
		{
			if(gs_MATRIX_info[i].Ticks >= gs_MATRIX_info[i].Max_Ticks)
			{
				if(gs_MATRIX_info[i].BufferInit == 1 && DOT_MATRIX_CfgParam[i].SCROLL_Mode == SCROLL_MODE)
				{
					if(gs_MATRIX_info[i].Col_Index == 5)
					{
						gs_MATRIX_info[i].Arr_Index++;
						gs_MATRIX_info[i].Col_Index = 0;
						space = 1;
					}
					if(gs_MATRIX_info[i].Arr_Index == gs_MATRIX_info[i].ArrSize)
					{
						gs_MATRIX_info[i].Arr_Index = 0;
					}
					if(space)
					{
						PushToBuffer(i, 0x00); // Add White Space To Separate Characters
					}
					else
					{
						ch = (*(gs_MATRIX_info[i].ArrPtr + gs_MATRIX_info[i].Arr_Index)-32);
						PushToBuffer(i, FONT_7x5[ch][gs_MATRIX_info[i].Col_Index++]);
					}
					MATRIX_display_buffer(i);
				}
				gs_MATRIX_info[i].Ticks = 0;
			}
			else
			{
				gs_MATRIX_info[i].Ticks++;
			}
		}
	}
}

void MATRIX_print_num(uint8_t au8_MATRIX_Instance, uint8_t num) {
    uint8_t ancho = 5;
    uint8_t alto = 8;

    uint8_t centro_x = 16;
    uint8_t centro_y = 16;

    uint8_t x_inicio = centro_x - ancho / 2;
    uint8_t y_inicio = centro_y - alto / 2;

    uint8_t num1[8][5] = {
		{0, 0, 1, 0, 0},
		{0, 1, 1, 0, 0},
		{1, 0, 1, 0, 0},
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		{1, 1, 1, 1, 1}
    };

    uint8_t num2[8][5] = {
		{0, 1, 1, 1, 0},
		{1, 0, 0, 0, 1},
		{0, 0, 0, 0, 1},
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		{1, 1, 1, 1, 1}
    };

    uint8_t num3[8][5] = {
		{1, 1, 1, 1, 1},
		{0, 0, 0, 1, 0},
		{0, 0, 1, 0, 0},
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		{1, 1, 1, 1, 0}
    };

    for (uint8_t i = 0; i < alto; i++) {
        for (uint8_t j = 0; j < ancho; j++) {
        	uint8_t estado_led;
        	MATRIX_set_led(au8_MATRIX_Instance, x_inicio + j, y_inicio + i, estado_led);
        	switch(num){
        	case 1:
        		estado_led = num1[i][j] == 1 ? MATRIX_LED_ON : MATRIX_LED_OFF;
        		break;
        	case 2:
        		estado_led = num2[i][j] == 1 ? MATRIX_LED_ON : MATRIX_LED_OFF;
        		break;
        	case 3:
        		estado_led = num3[i][j] == 1 ? MATRIX_LED_ON : MATRIX_LED_OFF;
        		break;
        	}
        	MATRIX_set_led(au8_MATRIX_Instance, x_inicio + j, y_inicio + i, estado_led);
        }
    }
    MATRIX_display_buffer(au8_MATRIX_Instance);
}

static uint8_t get_bit_state(uint32_t row, uint8_t col){
	uint32_t mask = 1 << col;
	uint32_t cell = mask & row;
	return cell ? 1 : 0;
}

void MATRIX_print_msg(uint8_t au8_MATRIX_Instance, uint8_t msg) {
	uint32_t *matrix;
	switch(msg){
	case WELCOME_MSG:
		matrix = welcome_msg;
		break;
	case PONG_MSG:
		matrix = pong_msg;
		break;
	case TETRIS_MSG:
		matrix = tetris_msg;
		break;
	case SNAKE_MSG:
		matrix = snake_msg;
		break;
	case CONWAY_MSG:
		matrix = conway_msg;
		break;
	case GAMEOVER_MSG:
		matrix = gameover_msg;
		break;
	}

	uint8_t state;
	for(uint8_t i=0; i<32; i++){
		for(uint8_t j=0; j<32; j++){
			state = get_bit_state(matrix[i], j);
			MATRIX_set_led(au8_MATRIX_Instance, 31-j, i, state);
		}
	}
	MATRIX_display_buffer(au8_MATRIX_Instance);
}




